## dts/bindings/pwm-servo.yaml
```yaml
description: PWM-driven servo motor

compatible: "pwm-servo"

include: base.yaml

properties:
  pwms:
    required: true
    type: phandle-array
    description: PWM specifier driving the servo motor

  min-pulse: 
    required: true
    type: int
    description: Minimum pulse width (nanoseconds)
  
  max-pulse: 
    required: true
    type: int
    description: Maximum pulse width (nanoseconds)
```
